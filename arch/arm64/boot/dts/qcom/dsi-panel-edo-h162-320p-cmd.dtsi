/* Copyright (c) 2013-2015, The Linux Foundation. All rights reserved.
 *
 * This program is free software; you can redistribute it and/or modify
 * it under the terms of the GNU General Public License version 2 and
 * only version 2 as published by the Free Software Foundation.
 *
 * This program is distributed in the hope that it will be useful,
 * but WITHOUT ANY WARRANTY; without even the implied warranty of
 * MERCHANTABILITY or FITNESS FOR A PARTICULAR PURPOSE.  See the
 * GNU General Public License for more details.
 */

&mdss_mdp {
	dsi_edo_h162_320p_cmd: qcom,mdss_dsi_edo_h162_320p_cmd {
		qcom,mdss-dsi-panel-name = "Edo H162 320p cmd mode dsi panel";
		qcom,mdss-dsi-panel-type = "dsi_cmd_mode";
		qcom,mdss-dsi-panel-framerate = <60>;
		qcom,mdss-dsi-virtual-channel-id = <0>;
		qcom,mdss-dsi-stream = <0>;
		qcom,mdss-dsi-panel-width = <320>;
		qcom,mdss-dsi-panel-height = <360>;
		qcom,mdss-dsi-h-front-porch = <100>;
		qcom,mdss-dsi-h-back-porch = <40>;
		qcom,mdss-dsi-h-pulse-width = <20>;
		qcom,mdss-dsi-h-sync-skew = <0>;
		qcom,mdss-dsi-v-back-porch = <12>;
		qcom,mdss-dsi-v-front-porch = <60>;
		qcom,mdss-dsi-v-pulse-width = <4>;
		qcom,mdss-dsi-h-left-border = <0>;
		qcom,mdss-dsi-h-right-border = <0>;
		qcom,mdss-dsi-v-top-border = <0>;
		qcom,mdss-dsi-v-bottom-border = <0>;
		qcom,mdss-dsi-bpp = <24>;
		qcom,mdss-dsi-color-order = "rgb_swap_rgb";
		qcom,mdss-dsi-underflow-color = <0xff>;
		qcom,mdss-dsi-border-color = <0>;
		qcom,mdss-dsi-on-command = [15 01 00 00 00 00 02 FE 00
					15 01 00 00 00 00 02 35 00
					15 01 00 00 00 00 02 51 FF
					15 01 00 00 00 00 02 53 20
					15 01 00 00 96 00 02 11 00
					15 01 00 00 00 00 02 29 00];
		qcom,mdss-dsi-off-command = [15 01 00 00 00 00 02 28 00
					15 01 00 00 78 00 02 10 00];
		qcom,mdss-dsi-on-command-state = "dsi_lp_mode";
		qcom,mdss-dsi-off-command-state = "dsi_lp_mode";
		qcom,mdss-dsi-idle-on-command = [23 01 00 00 00 00 02 FE 00
										 13 01 00 00 00 00 01 39];/* Idle-Mode On */
		qcom,mdss-dsi-idle-on-command-state = "dsi_hs_mode";
		qcom,mdss-dsi-idle-off-command = [23 01 00 00 00 00 02 FE 00
										  13 01 00 00 00 00 01 38];/* Idle-Mode Off */
		qcom,mdss-dsi-idle-off-command-state = "dsi_hs_mode";
		qcom,mdss-dsi-h-sync-pulse = <0>;
		qcom,mdss-dsi-traffic-mode = "burst_mode";
		qcom,mdss-dsi-bllp-eof-power-mode;
		qcom,mdss-dsi-bllp-power-mode;
		qcom,mdss-dsi-lane-0-state;
		qcom,mdss-dsi-te-pin-select = <1>;
		qcom,mdss-dsi-te-dcs-command = <1>;
		qcom,mdss-dsi-te-using-te-pin;
		//qcom,mdss-dsi-te-check-enable;
		qcom,mdss-dsi-panel-timings = [5D 12 0C 00 34 36 10 16 0F 03 04 00];
		qcom,mdss-dsi-t-clk-post = <0x05>;
		qcom,mdss-dsi-t-clk-pre = <0x21>;
		qcom,mdss-dsi-bl-min-level = <1>;
		qcom,mdss-dsi-bl-max-level = <255>;
		qcom,mdss-dsi-dma-trigger = "trigger_sw";
		qcom,mdss-dsi-mdp-trigger = "none";
		qcom,mdss-dsi-bl-pmic-control-type = "bl_ctrl_dcs";
		qcom,mdss-dsi-reset-sequence = <1 20>, <1 2>, <1 20>;
		/* clk = totalH * totalV * bpp * 60fps */
		qcom,mdss-dsi-panel-clockrate = <302060160>;
		qcom,mdss-pan-physical-width-dimension = <36>;
		qcom,mdss-pan-physical-height-dimension = <36>;
		//qcom,esd-check-enabled;
		qcom,mdss-dsi-panel-status-check-mode = "te_signal_check";
	};
};
