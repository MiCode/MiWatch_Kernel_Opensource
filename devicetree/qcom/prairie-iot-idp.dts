/dts-v1/;

#include "qcs610.dtsi"
#include "prairie-iot-idp.dtsi"

/ {
	model = "Qualcomm Technologies, Inc. QCS610 PM6150 IDP";
	compatible = "qcom,qcs610-idp", "qcom,qcs610", "qcom,idp";
	qcom,board-id = <34 0>;
};
