/dts-v1/;

#include "sa415m.dtsi"

/ {
	model = "Qualcomm Technologies, Inc. SA415M CCARD PCIE-EP";
	compatible = "qcom,sa415m-ccard",
			"qcom,sa415m", "qcom,ccard";
	qcom,board-id = <25 1>, <25 0x101>;
};

