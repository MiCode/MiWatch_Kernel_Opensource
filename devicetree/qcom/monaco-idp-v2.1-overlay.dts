/dts-v1/;
/plugin/;

#include "monaco-idp-v2.1.dtsi"
#include "monaco-slate-amic-audio-overlay.dtsi"

/ {
	model = "Qualcomm Technologies, Inc. Monaco Aon IDP V2.1";
	qcom,board-id = <0x020122 0x0>;
};
