/dts-v1/;
/plugin/;

#include "sa8195-vm.dtsi"
#include "sa8195-vm-lv-mt.dtsi"

/ {
	model = "Qualcomm Technologies, Inc. SA8195 Multi LV Virtual Machine";
	compatible = "qcom,sa8195p", "qcom,quinvm";
	qcom,pmic-name = "PM8195";
	qcom,board-id = <0 0x2000002>;
};
