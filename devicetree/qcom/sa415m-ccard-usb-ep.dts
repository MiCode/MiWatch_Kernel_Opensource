/dts-v1/;

#include "sa415m.dtsi"

/ {
	model = "Qualcomm Technologies, Inc. SA415M CCARD USB-EF";
	compatible = "qcom,sa415m-ccard",
			"qcom,sa415m", "qcom,ccard";
	qcom,board-id = <25 2>, <25 0x102>;
};

