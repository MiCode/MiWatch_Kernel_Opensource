/dts-v1/;
/plugin/;

#include "monaco-idp-v1.dtsi"
#include "monaco-slate-audio-overlay.dtsi"

/ {
	model = "Qualcomm Technologies, Inc. Monaco IDP V1.0";
	compatible = "qcom,monaco";
	qcom,board-id = <0x010022 0x0>;
};
