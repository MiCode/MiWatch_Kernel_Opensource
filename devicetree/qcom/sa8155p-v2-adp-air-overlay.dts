/dts-v1/;
/plugin/;

#include "sa8155-adp-star.dtsi"
#include "display/sa8155-adp-star-display-shd.dtsi"

/ {
	compatible = "qcom,sa8155p-v2-adp-air", "qcom,sa8155p",
		"qcom,sa8155p-iot", "qcom,adp-air";
	qcom,board-id = <0x01000019 0>;
};
