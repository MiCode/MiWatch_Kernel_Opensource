/dts-v1/;
/plugin/;

#include "sa8155-vm.dtsi"

/ {
	model = "Qualcomm Technologies, Inc. SA8155 Multi LA Virtual Machine";
	compatible = "qcom,sa8155";
	qcom,pmic-name = "PM8150";
	qcom,board-id = <0x2000001 0>, <0 0x2000001>;
};

