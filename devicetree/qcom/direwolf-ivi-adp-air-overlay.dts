/dts-v1/;
/plugin/;

#include "direwolf-adp-air.dtsi"
#include "display/direwolf-sde-display-adp-star.dtsi"

/ {
	model = "Qualcomm Technologies, Inc. DirewolfAU IVI ADP-AIR";
	compatible = "qcom,direwolf-ivi-adp-air", "qcom,direwolf-ivi",
		"qcom,direwolf", "qcom,adp-air";
	qcom,msm-id = <460 0x10000>;
	qcom,board-id = <0x01010019 0>;
};
