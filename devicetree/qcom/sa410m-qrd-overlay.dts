/dts-v1/;
/plugin/;

#include "sa410m-qrd.dtsi"

/ {
	model = "Qualcomm Technologies, Inc. SA410M QRD Overlay";
	compatible = "qcom,sa410m", "qcom,qrd", "qcom,sa410m-qrd";
	qcom,msm-id = <441 0x10000>, <471 0x10000>;
	qcom,board-id = <11 0x0>;
};
