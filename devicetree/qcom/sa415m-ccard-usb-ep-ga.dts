/dts-v1/;

#include "sa415m.dtsi"

/ {
	model = "Qualcomm Technologies, Inc. SA415M CCARD USB-EP GA";
	compatible = "qcom,sa415m-ccard",
			"qcom,sa415m", "qcom,ccard";
	qcom,board-id = <0x10119 2>;
};

