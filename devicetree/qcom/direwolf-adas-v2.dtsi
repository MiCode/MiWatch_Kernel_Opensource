#include "direwolf.dtsi"
#include "direwolf-ivi-regulators.dtsi"
#include "direwolf-pmic.dtsi"

/ {
	model = "Qualcomm Technologies, Inc. DirewolfAU ADAS V2 SoC";
	compatible = "qcom,direwolf-adas", "qcom,direwolf";
	qcom,msm-id = <461 0x20000>;
};

&gpucc {
	compatible = "qcom,direwolf-gpucc-v2", "syscon";
};

&videocc {
	compatible = "qcom,direwolf-videocc-v2", "syscon";
};
