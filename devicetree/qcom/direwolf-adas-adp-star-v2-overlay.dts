/dts-v1/;
/plugin/;

#include "direwolf-adp-star.dtsi"
#include "display/direwolf-sde-display-adp-star.dtsi"

/ {
	model = "Qualcomm Technologies, Inc. DirewolfAU ADAS V2 ADP-STAR";
	compatible = "qcom,direwolf-adas-adp-star", "qcom,direwolf-adas",
		"qcom,direwolf", "qcom,adp-star";
	qcom,msm-id = <461 0x20000>;
	qcom,board-id = <25 0>;
};
