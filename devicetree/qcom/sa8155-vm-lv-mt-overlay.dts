/dts-v1/;
/plugin/;

#include "sa8155-vm.dtsi"
#include "sa8155-vm-la.dtsi"

/ {
	model = "Qualcomm Technologies, Inc. SA8155 Multi LV Virtual Machine";
	compatible = "qcom,sa8155";
	qcom,pmic-name = "PM8150";
	qcom,board-id = <0 0x2000002>;
};

