&soc {
	/* GDSCs in Global CC */
	gdsc_mdss: qcom,gdsc@184d078 {
		compatible = "qcom,gdsc";
		regulator-name = "gdsc_mdss";
		reg = <0x184d078 0x4>;
		status = "disabled";
	};

	gdsc_oxili_gx: qcom,gdsc@185901c {
		compatible = "qcom,gdsc";
		regulator-name = "gdsc_oxili_gx";
		reg = <0x185901c 0x4>;
		status = "disabled";
	};
};
