#include "pmx55.dtsi"

#include <dt-bindings/pinctrl/qcom,pmic-gpio.h>

&pmx55_gpios {
	vreg_rgmii_off {
		vreg_rgmii_off_default: vreg_rgmii_off_default {
			pins = "gpio9";
			bias-pull-down;
			output-disable;
			input-enable;
		};
	};
};
