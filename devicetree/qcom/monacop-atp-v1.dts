/dts-v1/;

#include "monacop.dtsi"
#include "monaco-atp-v1.dtsi"

/ {
	model = "Qualcomm Technologies, Inc. MonacoP ATP V1.0";
	compatible = "qcom,monaco", "qcom,atp";
	qcom,board-id = <0x010021 0x0>;
};
