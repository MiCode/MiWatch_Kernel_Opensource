#include <dt-bindings/interrupt-controller/arm-gic.h>

&sdhc_1 {
	vdd-supply = <&L20A>;
	qcom,vdd-voltage-level = <2856000 2856000>;
	qcom,vdd-current-level = <0 570000>;

	vdd-io-supply = <&L14A>;
	qcom,vdd-io-always-on;
	qcom,vdd-io-lpm-sup;
	qcom,vdd-io-voltage-level = <1800000 1800000>;
	qcom,vdd-io-current-level = <0 325000>;

	pinctrl-names = "default", "sleep";
	pinctrl-0 = <&sdc1_on>;
	pinctrl-1 = <&sdc1_off>;

	status = "ok";
};

&sdhc_2 {
	vdd-supply = <&L21A>;
	qcom,vdd-voltage-level = <2960000 3300000>;
	qcom,vdd-current-level = <0 800000>;

	vdd-io-supply = <&L4A>;
	qcom,vdd-io-voltage-level = <1800000 2960000>;
	qcom,vdd-io-current-level = <0 22000>;

	pinctrl-names = "default", "sleep";
	pinctrl-0 = <&sdc2_on>;
	pinctrl-1 = <&sdc2_off>;

	cd-gpios = <&tlmm 88 GPIO_ACTIVE_HIGH>;

	status = "ok";
};

&scuba_snd {
	qcom,model = "bengal-scubaqrd-snd-card";
	qcom,msm-mi2s-master = <1>, <1>, <1>, <1>;
	qcom,audio-routing =
		"AMIC1", "Analog Mic1",
		"Analog Mic1","MIC BIAS1",
		"AMIC2", "Analog Mic2",
		"Analog Mic2", "MIC BIAS2",
		"AMIC3", "Analog Mic3",
		"Analog Mic3", "MIC BIAS3",
		"IN1_HPHL", "HPHL_OUT",
		"IN2_HPHR", "HPHR_OUT",
		"SpkrMono WSA_IN", "LO",
		"TX SWR_INPUT", "VA_TX_SWR_CLK",
		"TX SWR_INPUT", "ADC1_OUTPUT",
		"TX SWR_INPUT", "ADC2_OUTPUT",
		"RX_TX DEC0_INP", "TX DEC0 MUX",
		"RX_TX DEC1_INP", "TX DEC1 MUX",
		"RX_TX DEC2_INP", "TX DEC2 MUX",
		"RX_TX DEC3_INP", "TX DEC3 MUX",
		"TX_AIF1 CAP", "VA_TX_SWR_CLK",
		"TX_AIF2 CAP", "VA_TX_SWR_CLK",
		"TX_AIF3 CAP", "VA_TX_SWR_CLK",
		"VA SWR_INPUT", "VA_SWR_CLK",
		"VA_AIF1 CAP", "VA_SWR_CLK",
		"VA_AIF2 CAP", "VA_SWR_CLK",
		"VA_AIF3 CAP", "VA_SWR_CLK",
		"VA SWR_INPUT", "ADC1_OUTPUT",
		"VA SWR_INPUT", "ADC2_OUTPUT";
	qcom,msm-mbhc-hphl-swh = <1>;
	qcom,msm-mbhc-gnd-swh = <1>;
	qcom,cdc-dmic01-gpios = <&cdc_dmic01_gpios>;
	qcom,cdc-dmic23-gpios = <&cdc_dmic23_gpios>;
	qcom,pri-mi2s-gpios = <&prim_mi2s_gpios>;
	qcom,sec-mi2s-gpios = <&sec_mi2s_gpios>;
	qcom,tert-mi2s-gpios = <&tert_mi2s_gpios>;
	qcom,quat-mi2s-gpios = <&quat_mi2s_gpios>;

	nvmem-cells = <&adsp_variant>;
	nvmem-cell-names = "adsp_variant";
	asoc-codec  = <&stub_codec>, <&bolero>, <&rouleur_codec>, <&wsa881x_i2c_e>;
	asoc-codec-names = "msm-stub-codec.1", "bolero_codec", "rouleur_codec", "wsa-codec0";
	qcom,wsa-max-devs = <1>;
	qcom,wsa-devs = <&wsa881x_i2c_e>;
	qcom,wsa-aux-dev-prefix = "SpkrMono";
	qcom,codec-max-aux-devs = <0>;
	qcom,msm_audio_ssr_devs = <&audio_apr>, <&q6core>, <&bolero>,
				  <&lpi_tlmm>;
};

