/dts-v1/;
/plugin/;

#include "sa8155-adp-star.dtsi"
#include "display/sa8155-adp-star-display-shd.dtsi"

/ {
	compatible = "qcom,sa8155p-adp-star", "qcom,sa8155p",
		"qcom,sa8155p-iot", "qcom,adp-star";
	qcom,board-id = <25 0>;
};
