/dts-v1/;
/plugin/;

#include "sa8155-vm.dtsi"
#include "sa8155-vm-la.dtsi"

/ {
	model = "Qualcomm Technologies, Inc. SA8155 Single LV Virtual Machine";
	compatible = "qcom,sa8155";
	qcom,pmic-name = "PM8150";
	qcom,board-id = <0 0x1000002>;
};

