## devicetree/bindings/arm/msm/sleepstate-hlos.txt
```
Qualcomm Technologies, Inc. hlos_sleep_state driver using  SMSM framework.

Required properties:
-compatible : should be one of the following:
- "qcom,smp2p-hlos_sleep_state"
-qcom,smem-states : the relevant outgoing smp2p entry

Example:
qcom,hlos_sleep_state {
	compatible = "qcom,smp2p-hlos_sleep_state";
	qcom,smem-states = <&hlos_sleep_state_out 0>;
};
```

## devicetree/bindings/cpufreq/vm-cpufreq.txt
```
Virtual machine CPU frequency driver bindings
----------------------------------------------

Required properties:
- operating-points-v2: Refer to Documentation/devicetree/bindings/opp/opp.txt
    for details. The assumption is that cpu frequency and voltage are fixed on
    virtual machine, so there must be only 1 operating point for each cpu.
- capacity-dmips-mhz: Refer to Documentation/devicetree/bindings/arm/cpu-capacity.txt
- dynamic-power-coefficient: A u32 value that represents the running time
  dynamic power coefficient in units of uW/MHz/V^2.

Example:
cpus {
	#address-cells = <2>;
	#size-cells = <0>;

	cluster_0_opp_table: opp-table0 {
		compatible = "operating-points-v2";
		opp-shared;

		opp-2496000000 {
			opp-hz = /bits/ 64 <2496000000>;
			opp-microvolt = <980000>;
		};
	};

	cluster_1_opp_table: opp-table1 {
		compatible = "operating-points-v2";
		opp-shared;

		opp-1766400000 {
			opp-hz = /bits/ 64 <1766400000>;
			opp-microvolt = <888000>;
		};
	};

	CPU0: cpu@0 {
		device_type = "cpu";
		compatible = "arm,armv8";
		reg = <0x0 0x0>;
		capacity-dmips-mhz = <1024>;
		dynamic-power-coefficient = <431>;
		operating-points-v2 = <&cluster_0_opp_table>;
	};

	CPU1: cpu@1 {
		device_type = "cpu";
		compatible = "arm,armv8";
		reg = <0x0 0x1>;
		capacity-dmips-mhz = <1024>;
		dynamic-power-coefficient = <431>;
		operating-points-v2 = <&cluster_0_opp_table>;
	};

	CPU2: cpu@2 {
		device_type = "cpu";
		compatible = "arm,armv8";
		reg = <0x0 0x2>;
		capacity-dmips-mhz = <1024>;
		dynamic-power-coefficient = <431>;
		operating-points-v2 = <&cluster_0_opp_table>;
	};

	CPU3: cpu@3 {
		device_type = "cpu";
		compatible = "arm,armv8";
		reg = <0x0 0x3>;
		capacity-dmips-mhz = <1024>;
		dynamic-power-coefficient = <431>;
		operating-points-v2 = <&cluster_0_opp_table>;
	};

	CPU4: cpu@4 {
		device_type = "cpu";
		compatible = "arm,armv8";
		reg = <0x0 0x4>;
		capacity-dmips-mhz = <414>;
		dynamic-power-coefficient = <100>;
		operating-points-v2 = <&cluster_1_opp_table>;
	};

	CPU5: cpu@5 {
		device_type = "cpu";
		compatible = "arm,armv8";
		reg = <0x0 0x5>;
		capacity-dmips-mhz = <414>;
		dynamic-power-coefficient = <100>;
		operating-points-v2 = <&cluster_1_opp_table>;
	};

	CPU6: cpu@6 {
		device_type = "cpu";
		compatible = "arm,armv8";
		reg = <0x0 0x6>;
		capacity-dmips-mhz = <414>;
		dynamic-power-coefficient = <100>;
		operating-points-v2 = <&cluster_1_opp_table>;
	};

	CPU7: cpu@7 {
		device_type = "cpu";
		compatible = "arm,armv8";
		reg = <0x0 0x7>;
		capacity-dmips-mhz = <414>;
		dynamic-power-coefficient = <100>;
		operating-points-v2 = <&cluster_1_opp_table>;
	};
};
```

## devicetree/bindings/display/bridge/analogix,anx7625.txt
```
# SPDX-License-Identifier: (GPL-2.0 OR BSD-2-Clause)
# Copyright 2019 Analogix Semiconductor, Inc.

Analogix ANX7625 SlimPort (4K Mobile HD Transmitter)
----------------------------------------------------

The ANX7625 is an ultra-low power 4K Mobile HD Transmitter
designed for portable devices.

Required properties:

 - compatible       : "analogix,anx7625"
 - reg              : I2C address of the device
 - ports            : Port@0, Video port for MIPI DSI input
                      Port@1, Video port for panel or connector

Optional properties:

 - interrupts       : Used for interrupt pin B8
 - enable-gpios     : Used for power on chip control, POWER_EN pin D2
 - reset-gpios      : Used for reset chip control, RESET_N pin B7

Example:

	#include <dt-bindings/gpio/gpio.h>

	i2c0 {
		#address-cells = <1>;
		#size-cells = <0>;

		encoder@58 {
			compatible = "analogix,anx7625";
			reg = <0x58>;
			enable-gpios = <&pio 45 GPIO_ACTIVE_HIGH>;
			reset-gpios = <&pio 73 GPIO_ACTIVE_HIGH>;

			ports {
				#address-cells = <1>;
				#size-cells = <0>;

				mipi2dp_bridge_in: port@0 {
					reg = <0>;
					anx7625_in: endpoint {
						remote-endpoint = <&mipi_dsi>;
					};
				};

				mipi2dp_bridge_out: port@1 {
					reg = <1>;
					anx7625_out: endpoint {
						remote-endpoint = <&panel_in>;
					};
				};
			};
		};
	};
```

## devicetree/bindings/interconnect/qcom,sdx55.txt
```
Qualcomm Technologies, Inc. SDX55 Network-On-Chip interconnect driver binding
--------------------------------------------------------------------------------

SDX55 interconnect providers support system bandwidth requirements through
RPMh hardware accelerators known as Bus Clock Manager (BCM). The provider is
able to communicate with the BCM through the Resource State Coordinator (RSC)
associated with each execution environment. Provider nodes must point to at
least one RPMh device child node pertaining to their RSC and each provider
can map to multiple RPMh resources.

Required properties :
- compatible : shall contain only one of the following:
			"qcom,sdx55-ipa_virt",
			"qcom,sdx55-system_noc",
			"qcom,sdx55-mem_noc",
			"qcom,sdx55-mc_virt",
- #interconnect-cells : should contain 1

Examples:

system_noc: interconnect@1620000 {
	compatible = "qcom,sdx55-system_noc";
	interconnect-cells = <1>;
};
```

## devicetree/bindings/misc/qcom,ddr_bwprofiler.txt
```
Required properties :
- compatible : must be "qcom,ddr_bwprofiler"
- clocks : generally be <&aopcc QDSS_CLK>
- clock-names : must be "qdss_clk"

Example :
	ddr_bwprofiler {
		compatible = "qcom,ddr_bwprofiler";
		clocks = <&aopcc QDSS_CLK>;
		clock-names = "qdss_clk";
	};
```

## devicetree/bindings/net/qcom,ethqos-thin.txt
```
* Qualcomm Technologies, Inc. Ethernet thin driver (GMAC)

This documents dwmmac based ethernet device which supports Gigabit
ethernet for single TX and RX DMA channel pair.
There are 2 emac instances with DWMMAC HW version 0x30000000.
Either emac0 or emac1 instance is supported.
For emac0 instance, comaptible should be "qcom,stmmac-ethqos-emac0"

Required properties:
- compatible: Should be "qcom,stmmac-ethqos-emac1",

- reg: Address and length of the register set for the device

- reg-names: Should contain register name "stmmaceth"

- interrupts: Should contain the per channel interrupts

- interrupt-names: Should contain per channel interrupt names

- queue: queue index in MTL for this driver

Rest of the properties are defined in stmmac.txt file in same directory

Examples:

	mtl_rx_setup: rx-queues-config {
		snps,rx-queues-to-use = <1>;
		snps,rx-sched-sp;
		queue {
			snps,dcb-algorithm;
			snps,priority = <0x1>;
		};
	};

	mtl_tx_setup: tx-queues-config {
		snps,tx-queues-to-use = <1>;
		snps,tx-sched-sp;
		queue {
			snps,dcb-algorithm;
		};
	};

	emacthin_hw: ethernet@00020000 {
		compatible = "qcom,stmmac-ethqos-emac1";
		reg = <0x20000 0x10000>;
		interrupts-extended = <&intc 0 945 1>;
		interrupt-names = "tx_rx_ch1_intr";
		mac-address = [000000000000]; /* Filled in by U-Boot */

		rx-fifo-depth = <16384>;
		tx-fifo-depth = <16384>;
		snps,mtl-rx-config = <&mtl_rx_setup>;
		snps,mtl-tx-config = <&mtl_tx_setup>;
		queue = <2>
	};
```

## devicetree/bindings/pil/subsys-pil-slate.yaml
```yaml
%YAML 1.2
---
$id: http://devicetree.org/schemas/bindings/pil/subsys-pil-slate.yaml#
$schema: http://devicetree.org/meta-schemas/core.yaml#

title: Generic Subsystem Peripheral Image Loader


description: |+
  subsys-pil-slate is a generic peripheral image loader (PIL) driver. It is
  used for loading the firmware images of the slate subsystems into internal
  memory of slate SoC and preparing the subsystem's processor to execute code.
  It's also responsible for restarting slate SoC when it's gets crashed.

properties:
  compatible:
    oneOf:
      - const: qcom,pil-slate
        description:
          For implementations specific to subsystem PIL nodes. Could be more
          than one.

      - const: qcom,pil-tz-scm-pas
        description:
          For specifically registering with the interconnect framework, in
          order to satisfy the bandwidth requirements between the DDR and
          the crypto engine. This is so that the secure world can validate
          the PIL images. Only one node per device-tree is required.

  qcom,firmware-name:
    description: Base name of the firmware image.

  qcom,bg2ap-status-gpio:
	description: GPIO used by the blackghost to indicate status to the apps.
  qcom,ap2bg-status-gpio:
	description: GPIO used by the apps to indicate its status to blackghost.

required:
  - compatible
  - qcom,firmware-name

examples:
  - |

	qcom,slate {
		compatible = "qcom,pil-slate";
		qcom,pil-force-shutdown;
		qcom,firmware-name = "slate-wear";
		/* GPIO inputs from blackghost */
		qcom,slate2ap-status-gpio = <&tlmm 17 0>;
		/* GPIO output to blackghost */
		qcom,ap2slate-status-gpio = <&tlmm 16 0>;
	};
```

## devicetree/bindings/regulator/max20411-regulator.txt
```
Maxim MAX20411 voltage regulator

MAX20411 regulator is a high-efficiency, synchronous step-down converter
that operates with a 3.0V to 5.5V input voltage range and provideds
a 0.05V to 1.275V output range.

Properties:
- compatible
	Usage:      required
	Value type: <string>
	Definition: Must be "maxim,max20411".

- reg
	Usage:      required
	Value type: <u32>
	Definition: I2C slave address.

- enable-gpio:
	Usage:      required
	Value type: <phandle>
	Definition: Phandle to GPIO used to control enable status of regulator.

- regulator-name
	Usage:      required
	Value type: <string>
	Definition: Specifies the name for this regulator.

- regulator-min-microvolt
	Usage:      required
	Value type: <u32>
	Definition: This is the minimum supported voltage in microvolts.

- regulator-max-microvolt
	Usage:      required
	Value type: <u32>
	Definition: This is the maximum supported voltage in microvolts.


Example:
&qupv3_se12_i2c {
	VDD_GFX_LEVEL: max20411-regulator@39 {
		reg = <0x39>;
		compatible = "maxim,max20411";
		enable-gpio = <&pm8540_1_gpios 2 GPIO_ACTIVE_HIGH>;
		regulator-name = "max20411-vout";
		regulator-min-microvolt = <500000>;
		regulator-max-microvolt = <968750>;
	};
};
```

## devicetree/bindings/soc/qcom/rename_devices.txt
```
* rename devices

Required properties for block and net devices rename:

- compatible:		"qcom,rename-devices" compatibility string
- device-type:		Device type to be renamed and supported device-types are block and net
- actual-dev:		Original name of the disk or network interface assigned by generic driver
- rename-dev:		New name of the disk or network interface to set for disks or
			network interfaces respectively
- rename-dev-ab:	New name of the disk to set for a/b supported disks

Example:

rename_devices: rename_devices {
		compatible = "qcom,rename-devices";
		rename_blk: rename_blk {
			device-type = "block";
			actual-dev = "vda", "vdb", "vdc",
					"vdd", "vde", "vdf",
					"vdg", "vdh", "vdi";
			rename-dev = "system", "userdata", "vendor",
					"persist", "modem", "bluetooth",
					"misc", "vbmeta";
			rename-dev-ab = "super", "userdata", "metadata",
					"persist", "modem_a", "bluetooth_a",
					"misc", "vbmeta_a", "vbmeta_b";
		};

		rename_net: rename_net {
			device-type = "net";
			actual-dev = "eth0";
			rename-dev = "eth1";
		};
};
```

## drivers/char/i2c_devinfo/Kconfig
```kconfig
config I2C_DEVINFO
    tristate "I2c devices info for I2C testing"
    default y
    help
    This is the i2c-devinfo driver for android system
```

## drivers/input/misc/sar/Kconfig
```kconfig
config INPUT_SENSOR_HX9031A
	tristate "HX9031A based input"
	depends on I2C
	help
	  Say Y here if you have a input interface using the
	  HX9031A controller, and your board-specific initialization
	  code includes that in its table of I2C devices.

	  If unsure, say N (but it's safe to say "Y").

	  To compile this driver as a module, choose M here: the
	  module will be called hx9031a.
```
